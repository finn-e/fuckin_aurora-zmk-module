## boards/shields/fuckin_aurora/Kconfig.shield
```kconfig
config SHIELD_FUCKIN_AURORA_LEFT
    def_bool $(shields_list_contains, fuckin_aurora_left)

config SHIELD_FUCKIN_AURORA_RIGHT
    def_bool $(shields_list_contains, fuckin_aurora_right)
```
