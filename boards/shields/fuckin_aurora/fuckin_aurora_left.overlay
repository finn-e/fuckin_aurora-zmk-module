#include "fuckin_aurora.dtsi"
#include "boards/nice_nano_v2.overlay"


&kscan0 {
    diode-direction = "col2row";
    col-gpios
      = <&pro_micro 21 GPIO_ACTIVE_HIGH>
      , <&pro_micro 20 GPIO_ACTIVE_HIGH>
      , <&pro_micro 19 GPIO_ACTIVE_HIGH>
      , <&pro_micro 18 GPIO_ACTIVE_HIGH>
      , <&pro_micro 15 GPIO_ACTIVE_HIGH>
      , <&pro_micro 14 GPIO_ACTIVE_HIGH>
    ;
};

&led_strip {
    chain-length = <28>;
};